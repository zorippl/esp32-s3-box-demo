## example_front_desk/esp-cube/esp-napt-example/main/Kconfig.projbuild
```kconfig
menu "NAPT Example Configuration"

    config STA_SSID
        string "WiFi SSID"
        default "router"
        help
            SSID (network name) for the example to connect to.

    config STA_PASSWORD
        string "STA Password"
        default "12345678"
        help
            Password of the network the example to connect to.

    config AP_SSID
        string "AP SSID"
        default "esp_repeater"
        help
            SSID (network name) for the example to connect to.

    config AP_PASSWORD
        string "AP Password"
        default "12345678"
        help
            WiFi password (WPA or WPA2) for the example to use.

    config MANUAL_DNS
        bool "manually set dns address"
        default y

    config MANUAL_DNS_ADDR
        string  "main dns address"
        default "114.114.114.114"
        depends on MANUAL_DNS
endmenu
```

## example_front_desk/esp-cube/esp-napt-example/sdkconfig.defaults
```kconfig
CONFIG_LWIP_IP_FORWARD=y
CONFIG_LWIP_IPV4_NAPT=y

#
# DHCP server
#
CONFIG_LWIP_DHCPS=y
CONFIG_LWIP_DHCPS_LEASE_UNIT=60
CONFIG_LWIP_DHCPS_MAX_STATION_NUM=8
```

## example_meeting/esp-who/web_camera/sdkconfig.defaults.esp32s2
```kconfig
CONFIG_ESPTOOLPY_FLASHMODE_QIO=y
CONFIG_ESPTOOLPY_FLASHSIZE_4MB=y
CONFIG_PARTITION_TABLE_CUSTOM=y
CONFIG_PARTITION_TABLE_CUSTOM_FILENAME="partitions.csv"
CONFIG_PARTITION_TABLE_OFFSET=0x10000

CONFIG_CAMERA_MODEL_ESP32S2_BOARD=y
CONFIG_ESP32S2_DEFAULT_CPU_FREQ_240=y
CONFIG_ESP32S2_SPIRAM_SUPPORT=y
CONFIG_SPIRAM_SPEED_80M=y
CONFIG_SPIRAM_MALLOC_ALWAYSINTERNAL=1024
CONFIG_SPIRAM_TRY_ALLOCATE_WIFI_LWIP=y

CONFIG_ESP32_WIFI_STATIC_RX_BUFFER_NUM=10
CONFIG_ESP32_WIFI_RX_BA_WIN=6
CONFIG_FREERTOS_HZ=1000
```

## example_meeting/esp-who/web_camera/sdkconfig.defaults.esp32s3_opi
```kconfig
CONFIG_ESPTOOLPY_FLASHMODE_QIO=y
CONFIG_ESPTOOLPY_FLASHSIZE_4MB=y
CONFIG_PARTITION_TABLE_CUSTOM=y
CONFIG_PARTITION_TABLE_OFFSET=0x10000
CONFIG_CAMERA_MODEL_ESP32S3_BOARD=y
CONFIG_ESP32S3_DEFAULT_CPU_FREQ_240=y
CONFIG_ESP32S3_SPIRAM_SUPPORT=y
CONFIG_SPIRAM_SPEED_80M=y
CONFIG_SPIRAM_MALLOC_ALWAYSINTERNAL=4096
CONFIG_SPIRAM_TRY_ALLOCATE_WIFI_LWIP=y
CONFIG_FREERTOS_HZ=1000
CONFIG_ESPTOOLPY_NO_STUB=y
CONFIG_ESP_CONSOLE_USB_SERIAL_JTAG=y
CONFIG_SPIRAM_MODE_OCT=y
CONFIG_SPI_FLASH_USE_LEGACY_IMPL=y
```
